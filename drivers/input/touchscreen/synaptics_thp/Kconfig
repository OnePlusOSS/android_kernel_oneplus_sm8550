## drivers/input/touchscreen/synaptics_thp/Kconfig
```kconfig
#
# Synaptics TCM touchscreen driver configuration
#
menuconfig TOUCHSCREEN_SYNA_TCM2
	tristate "Synaptics TCM touchscreen"
	help
	  Say Y here if you have a Synaptics TCM touchscreen connected
	  to your system.

	  If unsure, say N.

	  To compile this driver as a module, choose M here.
```

## drivers/leds/aw210xx/Kconfig
```kconfig
config LEDS_AW210XX
	tristate "LED Support for AW210XX"
	depends on LEDS_CLASS && I2C
	help
	  this option enables support for the AW210XXRGB LED connected
	  through I2C. Say Y to enable support for the AW210XX LED
	  light automatically.
```

## drivers/power/Kconfig
```kconfig
# SPDX-License-Identifier: GPL-2.0-only
source "drivers/power/reset/Kconfig"
source "drivers/power/supply/Kconfig"

#ifdef OPLUS_FEATURE_CHG_BASIC
config OPLUS_CHG
	tristate "OPLUS CHARGER KO module"
	default m
	help
	  Enables support for the oplus charging framework

config OPLUS_SM8550_CHARGER
	bool "OPLUS SM8550 charger driver"
	help
	  Enables support for the sm8350 charging

config OPLUS_SHORT_C_BATT_CHECK
	bool "OPLUS_SHORT_C_BATT CHECK SUPPORT"
	default n
	help
	  Say Y to include support

config OPLUS_CALL_MODE_SUPPORT
	bool "OPLUS call mode support"
	help
	  Say Y to include support

config OPLUS_SMART_CHARGER_SUPPORT
	bool "OPLUS smart charger support"
	help
	  Say Y to include support

config OPLUS_SHORT_HW_CHECK
	bool "OPLUS_SHORT_HW CHECK SUPPORT"
	default n
	help
	  Say Y to include support

config OPLUS_CHIP_SOC_NODE
	bool "OPLUS chip soc node"
	help
	  Say Y to include support

config OPLUS_SHORT_IC_CHECK
	bool "OPLUS_SHORT_IC CHECK SUPPORT"
	default n
	help
	  Say Y to include support

config OPLUS_SHORT_USERSPACE
	bool "OPLUS batt userspace"
	help
	 Say Y to include support

config OPLUS_RTC_DET_SUPPORT
	bool "OPLUS RTC DET SUPPORT"
	default n
	help
	  Say Y to include support

config OPLUS_CHECK_CHARGERID_VOLT
	bool "OPLUS CHECK CHARGERID VOLT"
	default n
	help
	  Say Y to include support

config OPLUS_SHIP_MODE_SUPPORT
	bool "OPLUS_SHIP_MODE_SUPPORT"
	default n
	help
	  Say Y to include support

config OPLUS_CHG_DYNAMIC_CONFIG
	bool "OPLUS_CHG_DYNAMIC_CONFIG"
	default n
	help
	  Say Y to include support

config DISABLE_OPLUS_FUNCTION
	bool "DISABLE_OPLUS_FUNCTION for bringup compile"
	default n
	help
	  Say Y to include support

config OPLUS_CHG_DRM_PANEL_NOTIFY
	bool "OPLUS_CHG_DRM_PANEL_NOTIFY"
	default n
	help
	  Say Y to include support

source "drivers/power/oplus/Kconfig"

menuconfig OPLUS_CHG_V2
	tristate "OPLUS charging V2 system"
	default n
	depends on I2C
	select REGMAP_I2C
	help
	  Say Y here to enable OPLUS charging V2 system support

if OPLUS_CHG_V2
config OPLUS_SMART_CHARGE
	bool "smart charge"
	help
	  Say Y here to enable smart charge

config OPLUS_ADSP_SM8450_CHARGER
	bool "SM8450 support"
	help
	  Say Y here to declare sm8450 support

menuconfig OPLUS_CHG_VOOCPHY
	bool "OPLUS charging voocphy"
	help
	  Say Y here to enable OPLUS charging system support

config OPLUS_CHG_VOOCPHY_CHGLIB
	bool "voocphy chglib support"
	help
	  Say Y here to declare voocphy chglib support

config OPLUS_CHG_AP_VOOCPHY
	bool "ap voocphy support"
	depends on OPLUS_CHG_VOOCPHY_CHGLIB
	help
	  Say Y here to declare ap voocphy support

config OPLUS_VOOCPHY_SC8517
	bool "bidirect cp sc8517 support"
	depends on OPLUS_CHG_VOOCPHY_CHGLIB && OPLUS_CHG_AP_VOOCPHY
	help
	  Say Y here to declare bidirect cp sc8517 support

config OPLUS_UFCS_CLASS
	tristate "oplus ufcs class"
	default n
	help
	  Say Y or M to enable oplus ufcs class

config OPLUS_UFCS_SC2201
	bool "enable sc2201 ufcs phy"
	depends on OPLUS_UFCS_CLASS
	help
	  Say Y here to declare sc2201 ufcs phy support

config OPLUS_CHG_IC_DEBUG
	bool "Virtual IC layer debug interface"
	help
	  Say Y here to declare virtual IC layer debug interface

config OPLUS_CHG_MMS_DEBUG
	bool "Message subscription layer debug interface"
	help
	  Say Y here to declare message subscription layer debug interface

config OPLUS_DA9313_CHARGER
	bool "DA9313 support"
	help
	  Say Y here to declare DA9313 support

config OPLUS_MP2762_CHARGER
	bool "MP2762 support"
	help
	  Say Y here to declare MP2762 support

config OPLUS_SGM41512_CHARGER
	bool "SGM41512 support"
	help
	  Say Y here to declare SGM41512 support

config OPLUS_PD_MANAGER_CHARGER
	bool "PD_MANAGER support"
	help
	  Say Y here to declare PD_MANAGER support

config OPLUS_ADSP_CHARGER
	bool "ADSP support"
	help
	  Say Y here to declare ADSP support

config OPLUS_TPS6128XD_CHARGER
	bool "tps6128xd support"
	help
	  Say Y here to declare tps6128xd support
endif

#endif
```

## drivers/soc/Kconfig
```kconfig
# SPDX-License-Identifier: GPL-2.0-only
menu "SOC (System On Chip) specific Drivers"

source "drivers/soc/actions/Kconfig"
source "drivers/soc/amlogic/Kconfig"
source "drivers/soc/aspeed/Kconfig"
source "drivers/soc/atmel/Kconfig"
source "drivers/soc/bcm/Kconfig"
source "drivers/soc/canaan/Kconfig"
source "drivers/soc/fsl/Kconfig"
source "drivers/soc/imx/Kconfig"
source "drivers/soc/ixp4xx/Kconfig"
source "drivers/soc/litex/Kconfig"
source "drivers/soc/mediatek/Kconfig"
source "drivers/soc/qcom/Kconfig"
source "drivers/soc/renesas/Kconfig"
source "drivers/soc/rockchip/Kconfig"
source "drivers/soc/samsung/Kconfig"
source "drivers/soc/sifive/Kconfig"
source "drivers/soc/sunxi/Kconfig"
source "drivers/soc/tegra/Kconfig"
source "drivers/soc/ti/Kconfig"
source "drivers/soc/ux500/Kconfig"
source "drivers/soc/versatile/Kconfig"
source "drivers/soc/xilinx/Kconfig"

config OPLUS_SYSTEM_KERNEL
  bool "config oplus system feature "
  default y
  help
	define this config to add oplus sytstem kernel feature

#ifdef OPLUS_FEATURE_MM_FEEDBACK
source "drivers/soc/oplus/multimedia/Kconfig"
#endif /* OPLUS_FEATURE_MM_FEEDBACK */

#ifdef OPLUS_FEATURE_SENSOR_SMEM
source "drivers/soc/oplus/sensor/Kconfig"
#endif /* OPLUS_FEATURE_SENSOR_SMEM */

#ifdef OPLUS_FEATURE_SENSOR_CONSUMER_IR
source "drivers/soc/oplus/oplus_consumer_ir/Kconfig"
#endif /* OPLUS_FEATURE_SENSOR_CONSUMER_IR */

#ifdef OPLUS_FEATURE_DFT
source "drivers/soc/oplus/dft/Kconfig"
#endif /* ifdef OPLUS_FEATURE_DFT */

#ifdef OPLUS_FEATURE_DFR
source "drivers/soc/oplus/dfr/Kconfig"
#endif /* OPLUS_FEATURE_DFR */

#ifdef OPLUS_FEATURE_BOOT
source "drivers/soc/oplus/boot/Kconfig"
#endif /* OPLUS_FEATURE_BOOT */

#ifdef OPLUS_FEATURE_OCH
source "kernel/oplus_cpu/cpufreq_health/Kconfig"
#endif /* OPLUS_FEATURE_OCH */

#ifdef OPLUS_FEATURE_OMRG
source "kernel/oplus_cpu/oplus_omrg/Kconfig"
#endif /* OPLUS_FEATURE_OMRG */

#ifdef OPLUS_FEATURE_ATD
source "kernel/oplus_cpu/detection/Kconfig"
#endif /* OPLUS_FEATURE_ATD */

#ifdef OPLUS_FEATURE_SUGOV_POWER_EFFIENCY
source "kernel/oplus_cpu/cpufreq_effiency/Kconfig"
#endif /* OPLUS_FEATURE_SUGOV_POWER_EFFIENCY */

#ifdef OPLUS_FEATURE_GKI_CPUFREQ_BOUNCING
source "kernel/oplus_cpu/cpufreq_bouncing/Kconfig"
#endif /* OPLUS_FEATURE_GKI_CPUFREQ_BOUNCING */

source "kernel/oplus_cpu/uad/Kconfig"

#ifdef OPLUS_FEATURE_MDMFEATURE
source "drivers/soc/oplus/mdmfeature/Kconfig"
#endif /*OPLUS_FEATURE_MDMFEATURE*/

#ifdef OPLUS_FEATURE_MODEM_MINIDUMP
source "drivers/soc/oplus/mdmrst/Kconfig"
#endif /*OPLUS_FEATURE_MODEM_MINIDUMP*/

#ifdef OPLUS_FEATURE_MIDAS
source "drivers/soc/oplus/midas/Kconfig"
#endif /*OPLUS_FEATURE_MIDAS*/
endmenu

#ifdef OPLUS_FEATURE_TP_BASIC
source "drivers/soc/oplus/device_info/Kconfig"
#endif /* OPLUS_FEATURE_TP_BASIC */

#ifdef OPLUS_FEATURE_ABNORMAL_FLAG
source "kernel/oplus_cpu/oplus_overload/Kconfig"
#endif /* OPLUS_FEATURE_ABNORMAL_FLAgit G */

#ifdef OPLUS_FREEZE_DEBUG
source "drivers/soc/oplus/power/freeze_debug/Kconfig"
#endif /* OPLUS_FREEZE_DEBUG */
```

## drivers/staging/pseudo-sensor/Kconfig
```kconfig
# SPDX-License-Identifier: GPL-2.0
config PSEUDO_SENSOR
    tristate "Allow pseudo sensor debugging interface"
    default n
    help
      This module adds support pseudo sensor.
      Enable pseudo sensor debugging interface
      The driver creates a series of interfaces in the /proc for user mode
      The driver provides contiguous memory for SLPI use

config OPLUS_SENSOR_DEBUG_KIT
    tristate "Allow sensor debug kit interface"
    default n
    help
      This module adds support sensor debug kit.
      Enable sensor debug kit interface
      The driver creates a series of interfaces in the /proc for user mode
      The driver provides contiguous memory for ADSP/SLPI use
```
